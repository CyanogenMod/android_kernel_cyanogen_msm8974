/* Copyright (c) 2013, The Linux Foundation. All rights reserved.
 *
 * This program is free software; you can redistribute it and/or modify
 * it under the terms of the GNU General Public License version 2 and
 * only version 2 as published by the Free Software Foundation.
 *
 * This program is distributed in the hope that it will be useful,
 * but WITHOUT ANY WARRANTY; without even the implied warranty of
 * MERCHANTABILITY or FITNESS FOR A PARTICULAR PURPOSE.  See the
 * GNU General Public License for more details.
 */

&mdss_mdp {
		dsi_tianma_nt35596_vid: qcom,mdss_dsi_tianma_nt35596_1080p_video {
		qcom,cont-splash-enabled;
		qcom,mdss-dsi-panel-name = "TIANMA nt35596 1080p video mode dsi panel";
		qcom,mdss-dsi-panel-controller = <&mdss_dsi0>;
		qcom,mdss-dsi-panel-type = "dsi_video_mode";
		qcom,mdss-dsi-panel-destination = "display_1";
		qcom,mdss-dsi-panel-framerate = <60>;
		qcom,mdss-dsi-virtual-channel-id = <0>;
		qcom,mdss-dsi-stream = <0>;
		qcom,mdss-dsi-panel-width = <1080>;
		qcom,mdss-dsi-panel-height = <1920>;
		qcom,mdss-dsi-h-front-porch = <96>;
		qcom,mdss-dsi-h-back-porch = <16>;
		qcom,mdss-dsi-h-pulse-width = <4>;
		qcom,mdss-dsi-h-sync-skew = <0>;
		qcom,mdss-dsi-v-back-porch = <8>;
		qcom,mdss-dsi-v-front-porch = <16>;
		qcom,mdss-dsi-v-pulse-width = <2>;
		qcom,mdss-dsi-h-left-border = <0>;
		qcom,mdss-dsi-h-right-border = <0>;
		qcom,mdss-dsi-v-top-border = <0>;
		qcom,mdss-dsi-v-bottom-border = <0>;
		qcom,mdss-dsi-bpp = <24>;
		qcom,mdss-dsi-color-order = <0>;
		qcom,mdss-dsi-underflow-color = <0x00>;
		qcom,mdss-dsi-border-color = <0>;
//		qcom,mdss-dsi-panel-broadcast-mode;
		qcom,mdss-dsi-lp11-init;

		qcom,mdss-dsi-on-command = [
//ce settings
29 00 00 00 00 00 02 FF 03
29 00 00 00 00 00 02 FB 01
29 00 00 00 00 00 02 00 23
29 00 00 00 00 00 02 01 26
29 00 00 00 00 00 02 02 2B
29 00 00 00 00 00 02 03 2C
29 00 00 00 00 00 02 04 2D
29 00 00 00 00 00 02 05 2D
29 00 00 00 00 00 02 06 30
29 00 00 00 00 00 02 07 30
29 00 00 00 00 00 02 08 32
29 00 00 00 00 00 02 09 32
29 00 00 00 00 00 02 0A 32
29 00 00 00 00 00 02 0B 32
29 00 00 00 00 00 02 0C 37
29 00 00 00 00 00 02 0D 3C
29 00 00 00 00 00 02 0E 50
29 00 00 00 00 00 02 0F 5A
29 00 00 00 00 00 02 10 5A
29 00 00 00 00 00 02 11 5A
29 00 00 00 00 00 02 12 50
29 00 00 00 00 00 02 13 46
29 00 00 00 00 00 02 1B 0F
29 00 00 00 00 00 02 1C 14
29 00 00 00 00 00 02 1D 17
29 00 00 00 00 00 02 1E 19
29 00 00 00 00 00 02 1F 19
29 00 00 00 00 00 02 20 19
29 00 00 00 00 00 02 21 19
29 00 00 00 00 00 02 22 19
29 00 00 00 00 00 02 23 17
29 00 00 00 00 00 02 24 14
29 00 00 00 00 00 02 25 12
29 00 00 00 00 00 02 26 0F
29 00 00 00 00 00 02 27 0A
29 00 00 00 00 00 02 28 0A
29 00 00 00 00 00 02 29 08
29 00 00 00 00 00 02 2A 05
29 00 00 00 00 00 02 2B 03
29 00 00 00 00 00 02 2F 00
29 00 00 00 00 00 02 30 00
29 00 00 00 00 00 02 31 00
29 00 00 00 00 00 02 32 9D
29 00 00 00 00 00 02 33 A3
29 00 00 00 00 00 02 34 A6
29 00 00 00 00 00 02 35 08
29 00 00 00 00 00 02 36 0A
29 00 00 00 00 00 02 37 0C
29 00 00 00 00 00 02 38 0E
29 00 00 00 00 00 02 39 10
29 00 00 00 00 00 02 3A 12
29 00 00 00 00 00 02 3B 14
29 00 00 00 00 00 02 3F 16
29 00 00 00 00 00 02 40 18
29 00 00 00 00 00 02 41 1A
29 00 00 00 00 00 02 42 18
29 00 00 00 00 00 02 43 16
29 00 00 00 00 00 02 44 14
29 00 00 00 00 00 02 45 12
29 00 00 00 00 00 02 46 10
29 00 00 00 00 00 02 47 0E
29 00 00 00 00 00 02 48 0C
29 00 00 00 00 00 02 49 0A
29 00 00 00 00 00 02 4A 08
29 00 00 00 00 00 02 4B A8
29 00 00 00 00 00 02 4C A4
29 00 00 00 00 00 02 4D 00
29 00 00 00 00 00 02 4E 02
29 00 00 00 00 00 02 4F 0A
29 00 00 00 00 00 02 1A 00
29 00 00 00 00 00 02 53 07
29 00 00 00 00 00 02 54 77
29 00 00 00 00 00 02 55 77
29 00 00 00 00 00 02 58 EF
29 00 00 00 00 00 02 59 EF
29 00 00 00 00 00 02 5A EF
29 00 00 00 00 00 02 5B 00
29 00 00 00 00 00 02 5C EF
29 00 00 00 00 00 02 5D EF
29 00 00 00 00 00 02 5E EF
29 00 00 00 00 00 02 5F 24
29 00 00 00 00 00 02 63 00
//flicker
29 00 00 00 00 00 02 FF 05
29 00 00 00 00 00 02 FB 01
29 00 00 00 00 00 02 35 79
29 00 00 00 00 00 02 7F 1A
29 00 00 00 00 00 02 81 0A
29 00 00 00 00 00 02 82 02
//init code
29 00 00 00 00 00 02 FF 04
29 00 00 00 00 00 02 FB 01
29 00 00 00 00 00 02 08 0c
29 00 00 00 00 00 02 33 05
29 00 00 00 00 00 02 FF 00
29 00 00 00 00 00 02 35 00
29 00 00 00 00 00 02 D3 0a
29 00 00 00 00 00 02 D4 10
29 00 00 00 00 00 02 51 01
29 01 00 00 00 00 02 53 2c
//29 01 00 00 00 00 02 55 03
29 00 00 00 00 00 02 FF 00
15 01 00 00 78 00 02 11 00
15 01 00 00 14 00 02 29 00
			];
		qcom,mdss-dsi-off-command = [05 01 00 00 32 00 02 28 00
					05 01 00 00 78 00 02 10 00];

		qcom,mdss-dsi-on-command-state = "dsi_lp_mode";
		qcom,mdss-dsi-off-command-state = "dsi_hs_mode";
		qcom,mdss-dsi-panel-status-command = [06 01 00 01 05 00 02 0A 08];
		qcom,mdss-dsi-panel-status-command-state = "dsi_lp_mode";
		qcom,mdss-dsi-panel-status-check-mode = "reg_read";
		qcom,mdss-dsi-panel-status-value = <0x9c>;
		qcom,mdss-dsi-h-sync-pulse = <0>;
		qcom,mdss-dsi-traffic-mode = "non_burst_sync_event";
		qcom,mdss-dsi-lane-map = <0>;
		qcom,mdss-dsi-bllp-eof-power-mode;
		qcom,mdss-dsi-bllp-power-mode;
		qcom,mdss-dsi-lane-0-state;
		qcom,mdss-dsi-lane-1-state;
		qcom,mdss-dsi-lane-2-state;
		qcom,mdss-dsi-lane-3-state;
		qcom,mdss-dsi-panel-timings = [DB 34 22 00 64 66 28 38 2B 03 04 00];
		qcom,mdss-dsi-t-clk-post = <0x20>;
		qcom,mdss-dsi-t-clk-pre = <0x3e>;
		qcom,mdss-dsi-bl-min-level = <1>;
		qcom,mdss-dsi-bl-max-level = <255>;
		qcom,mdss-dsi-dma-trigger = "trigger_sw";
		qcom,mdss-dsi-mdp-trigger = "none";
		qcom,mdss-dsi-bl-pmic-control-type = "bl_ctrl_dcs";
		//qcom,mdss-dsi-bl-pmic-control-type = "bl_ctrl_pwm";
		qcom,mdss-dsi-bl-pmic-pwm-frequency = <50>;
		qcom,mdss-dsi-bl-pmic-bank-select = <2>;
		qcom,mdss-dsi-pwm-gpio = <&pm8941_gpios 26 0>;
		qcom,mdss-dsi-reset-sequence = <1 20>, <0 200>, <1 20>;
	};
};
