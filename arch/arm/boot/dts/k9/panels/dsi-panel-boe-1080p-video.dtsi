/* Copyright (c) 2013, The Linux Foundation. All rights reserved.
 *
 * This program is free software; you can redistribute it and/or modify
 * it under the terms of the GNU General Public License version 2 and
 * only version 2 as published by the Free Software Foundation.
 *
 * This program is distributed in the hope that it will be useful,
 * but WITHOUT ANY WARRANTY; without even the implied warranty of
 * MERCHANTABILITY or FITNESS FOR A PARTICULAR PURPOSE.  See the
 * GNU General Public License for more details.
 */

&mdss_mdp {
		dsi_boe_nt35596_vid: qcom,mdss_dsi_boe_nt35596_1080p_video {
		qcom,cont-splash-enabled;
		qcom,mdss-dsi-panel-name = "BOE nt35596 1080p video mode dsi panel";
		qcom,mdss-dsi-panel-controller = <&mdss_dsi0>;
		qcom,mdss-dsi-panel-type = "dsi_video_mode";
		qcom,mdss-dsi-panel-destination = "display_1";
		qcom,mdss-dsi-panel-framerate = <60>;
		qcom,mdss-dsi-virtual-channel-id = <0>;
		qcom,mdss-dsi-stream = <0>;
		qcom,mdss-dsi-panel-width = <1080>;
		qcom,mdss-dsi-panel-height = <1920>;
		qcom,mdss-dsi-h-front-porch = <32>;
		qcom,mdss-dsi-h-back-porch = <16>;
		qcom,mdss-dsi-h-pulse-width = <4>;
		qcom,mdss-dsi-h-sync-skew = <0>;
		qcom,mdss-dsi-v-back-porch = <8>;
		qcom,mdss-dsi-v-front-porch = <16>;
		qcom,mdss-dsi-v-pulse-width = <2>;
		qcom,mdss-dsi-h-left-border = <0>;
		qcom,mdss-dsi-h-right-border = <0>;
		qcom,mdss-dsi-v-top-border = <0>;
		qcom,mdss-dsi-v-bottom-border = <0>;
		qcom,mdss-dsi-bpp = <24>;
		qcom,mdss-dsi-color-order = <0>;
		qcom,mdss-dsi-underflow-color = <0xff>;
		qcom,mdss-dsi-border-color = <0>;
//		qcom,mdss-dsi-panel-broadcast-mode;
//		qcom,mdss-dsi-lp11-init;

		qcom,mdss-dsi-on-command = [
29 01 00 00 00 00 02 FF 01
29 01 00 00 00 00 02 FB 01
29 01 00 00 00 00 02 00 01
29 01 00 00 00 00 02 01 55
29 01 00 00 00 00 02 02 40
29 01 00 00 00 00 02 05 50
29 01 00 00 00 00 02 06 7A
29 01 00 00 00 00 02 07 3C
29 01 00 00 00 00 02 08 0C
29 01 00 00 00 00 02 11 19
29 01 00 00 00 00 02 12 19
29 01 00 00 00 00 02 13 03
29 01 00 00 00 00 02 14 7A
29 01 00 00 00 00 02 15 12
29 01 00 00 00 00 02 16 12          
29 01 00 00 00 00 02 0B A5          
29 01 00 00 00 00 02 0C A5          
29 01 00 00 00 00 02 0E AB          
29 01 00 00 00 00 02 0F AE          
29 01 00 00 00 00 02 58 82      
29 01 00 00 00 00 02 59 02
29 01 00 00 00 00 02 5A 02           
29 01 00 00 00 00 02 5B 02     
29 01 00 00 00 00 02 5C 82      
29 01 00 00 00 00 02 5D 82     
29 01 00 00 00 00 02 5E 02
29 01 00 00 00 00 02 5F 02
29 01 00 00 00 00 02 FF 05
29 01 00 00 00 00 02 FB 01
29 01 00 00 00 00 02 00 00                                 
29 01 00 00 00 00 02 01 01                                 
29 01 00 00 00 00 02 02 0B
29 01 00 00 00 00 02 03 0C                                  
29 01 00 00 00 00 02 04 00                                   
29 01 00 00 00 00 02 05 03
29 01 00 00 00 00 02 06 00                                   
29 01 00 00 00 00 02 07 04                                   
29 01 00 00 00 00 02 08 0F
29 01 00 00 00 00 02 09 00                                   
29 01 00 00 00 00 02 0A 00                                   
29 01 00 00 00 00 02 0B 00                                    
29 01 00 00 00 00 02 0C 00                              
29 01 00 00 00 00 02 0D 17                                 
29 01 00 00 00 00 02 0E 15                                 
29 01 00 00 00 00 02 0F 13                                  
29 01 00 00 00 00 02 10 00
29 01 00 00 00 00 02 11 01                                                              
29 01 00 00 00 00 02 12 0B
29 01 00 00 00 00 02 13 0C                                  
29 01 00 00 00 00 02 14 00                                                                  
29 01 00 00 00 00 02 15 03
29 01 00 00 00 00 02 16 00                                                                     
29 01 00 00 00 00 02 17 04                                  
29 01 00 00 00 00 02 18 0F                                   
29 01 00 00 00 00 02 19 00                                   
29 01 00 00 00 00 02 1A 00                                   
29 01 00 00 00 00 02 1B 00                                   
29 01 00 00 00 00 02 1C 00                                
29 01 00 00 00 00 02 1D 17                                 
29 01 00 00 00 00 02 1E 15
29 01 00 00 00 00 02 1F 13
29 01 00 00 00 00 02 20 09                                 
29 01 00 00 00 00 02 21 03
29 01 00 00 00 00 02 22 00
29 01 00 00 00 00 02 23 00
29 01 00 00 00 00 02 24 00                                   
29 01 00 00 00 00 02 25 3D
29 01 00 00 00 00 02 29 38
29 01 00 00 00 00 02 2A 2B                               
29 01 00 00 00 00 02 2F 02
29 01 00 00 00 00 02 30 01                              
29 01 00 00 00 00 02 31 49                          
29 01 00 00 00 00 02 32 23
29 01 00 00 00 00 02 33 01                           
29 01 00 00 00 00 02 34 06
29 01 00 00 00 00 02 35 6E                              
29 01 00 00 00 00 02 36 00                                  
29 01 00 00 00 00 02 37 2D
29 01 00 00 00 00 02 38 08
29 01 00 00 00 00 02 5B 00
29 01 00 00 00 00 02 5F 1D
29 01 00 00 00 00 02 63 00
29 01 00 00 00 00 02 67 04
29 01 00 00 00 00 02 6c 55
29 01 00 00 00 00 02 7A 00                                
29 01 00 00 00 00 02 7B A2                                 
29 01 00 00 00 00 02 7C D8
29 01 00 00 00 00 02 7D 50                     
29 01 00 00 00 00 02 7E 0D
29 01 00 00 00 00 02 7F 19
29 01 00 00 00 00 02 81 06
29 01 00 00 00 00 02 82 02
29 01 00 00 00 00 02 84 03
29 01 00 00 00 00 02 85 05
29 01 00 00 00 00 02 80 00 
29 01 00 00 00 00 02 83 00
29 01 00 00 00 00 02 92 94
29 01 00 00 00 00 02 93 08
29 01 00 00 00 00 02 94 0A
29 01 00 00 00 00 02 8A 33                     
29 01 00 00 00 00 02 A4 0F
29 01 00 00 00 00 02 9B 0F
29 01 00 00 00 00 02 E7 80                                   
29 01 00 00 00 00 02 E3 02                                 
29 01 00 00 00 00 02 FF 00
29 01 00 00 00 00 02 FB 01
29 01 00 00 00 00 02 D2 03
29 01 00 00 00 00 02 D3 0A
29 01 00 00 00 00 02 D4 0A
29 01 00 00 00 00 02 35 00

29 01 00 00 00 00 02 FF 04
29 01 00 00 00 00 02 FB 01
29 01 00 00 00 00 02 08 0c
29 01 00 00 00 00 02 33 05

29 01 00 00 00 00 02 51 FF
29 01 00 00 00 00 02 53 2c
29 01 00 00 00 00 02 55 03

//29 01 00 00 00 00 02 FF 05
//29 01 00 00 00 00 02 FB 01
//29 01 00 00 00 00 02 EA FF
//29 01 00 00 00 00 02 EB 27
//29 01 00 00 00 00 02 EC 01
//29 01 00 00 00 00 02 36 80
29 01 00 00 78 00 02 11 00
29 01 00 00 28 00 02 29 00
			];
		qcom,mdss-dsi-off-command = [05 01 00 00 32 00 02 28 00
					05 01 00 00 78 00 02 10 00];

		cm,mdss-livedisplay-cabc-cmd = [
			15 01 00 00 10 00 02 55 00];
		cm,mdss-livedisplay-cabc-ui-value = <0x01>;
		cm,mdss-livedisplay-cabc-image-value = <0x02>;
		cm,mdss-livedisplay-cabc-video-value = <0x03>;
		cm,mdss-livedisplay-sre-weak-value = <0x50>;
		cm,mdss-livedisplay-sre-medium-value = <0x60>;
		cm,mdss-livedisplay-sre-strong-value = <0x70>;
		cm,mdss-livedisplay-aco-value = <0x80>;
		cm,mdss-livedisplay-post-cmd = [
			15 01 00 00 14 00 02 29 00];
		qcom,mdss-dsi-on-command-state = "dsi_lp_mode";
		qcom,mdss-dsi-off-command-state = "dsi_hs_mode";
		qcom,mdss-dsi-h-sync-pulse = <0>;
		qcom,mdss-dsi-traffic-mode = "non_burst_sync_event";
		qcom,mdss-dsi-lane-map = <0>;
		qcom,mdss-dsi-bllp-eof-power-mode;
		qcom,mdss-dsi-bllp-power-mode;
		qcom,mdss-dsi-lane-0-state;
		qcom,mdss-dsi-lane-1-state;
		qcom,mdss-dsi-lane-2-state;
		qcom,mdss-dsi-lane-3-state;
		qcom,mdss-dsi-panel-timings =[BC 3E 34 00 55 4F 33 40 50 03 04 00]; 
		qcom,mdss-dsi-t-clk-post = <0x20>;
		qcom,mdss-dsi-t-clk-pre = <0x3e>;
		qcom,mdss-dsi-bl-min-level = <1>;
		qcom,mdss-dsi-bl-max-level = <255>;
		qcom,mdss-dsi-dma-trigger = "trigger_sw";
		qcom,mdss-dsi-mdp-trigger = "none";
		qcom,mdss-dsi-bl-pmic-control-type = "bl_ctrl_dcs";
                //qcom,mdss-dsi-bl-pmic-control-type = "bl_ctrl_pwm";
                qcom,mdss-dsi-bl-pmic-pwm-frequency = <50>;
                qcom,mdss-dsi-bl-pmic-bank-select = <2>;
                qcom,mdss-dsi-pwm-gpio = <&pm8941_gpios 26 0>;
                qcom,mdss-dsi-reset-sequence = <1 20>, <0 200>, <1 20>;
	};
};
